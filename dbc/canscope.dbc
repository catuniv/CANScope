VERSION ""

NS_ :

BS_ :
BU_ : ECU

BO_ 256 EngineData: 2 ECU
    SG_ EngineRPM : 0|16@1+ (1,0) [0|8000] "rpm" ECU

BO_ 257 VehicleData: 1 ECU
    SG_ VehicleSpeed : 0|8@1+ (1,0) [0|255] "km/h" ECU

BO_ 258 BatteryData: 1 ECU
    SG_ BatteryLevel : 0|8@1+ (1,0) [0|100] "%" ECU
